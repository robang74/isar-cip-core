## Kconfig
```kconfig
mainmenu "Isar core layer of the Civil Infrastructure Platform project"

config KAS_INCLUDE_MAIN
	string
	default "kas-cip.yml"

config KAS_BUILD_SYSTEM
	string
	default "isar"

choice
	prompt "Target board"
	default TARGET_QEMU_AMD64

config TARGET_QEMU_AMD64
	bool "QEMU AMD64 (x86-64)"

config TARGET_SIMATIC_IPC227E
	bool "Siemens SIMATIC IPC227E"

config TARGET_QEMU_ARM64
	bool "QEMU ARM64 (aarch64)"

config TARGET_HIHOPE_RZG2M
	bool "HopeRun HiHope-RZ/G2M"

config TARGET_QEMU_ARM
	bool "QEMU ARM (armhf)"

config TARGET_BBB
	bool "BeagleBone Black"

config TARGET_IWG20D
	bool "iWave Systems RainboW-G20D-Qseven"

endchoice

config KAS_INCLUDE_BOARD
	string
	default "kas/board/qemu-amd64.yml" if TARGET_QEMU_AMD64
	default "kas/board/simatic-ipc227e.yml" if TARGET_SIMATIC_IPC227E
	default "kas/board/qemu-arm64.yml" if TARGET_QEMU_ARM64
	default "kas/board/hihope-rzg2m.yml" if TARGET_HIHOPE_RZG2M
	default "kas/board/qemu-arm.yml" if TARGET_QEMU_ARM
	default "kas/board/bbb.yml" if TARGET_BBB
	default "kas/board/iwg20m.yml" if TARGET_IWG20D

comment "Kernel options"

choice
	prompt "CIP kernel version"
	default KERNEL_4_19

config KERNEL_4_4
	bool "Kernel 4.4.x-cip"

config KERNEL_4_19
	bool "Kernel 4.19.x-cip"

endchoice

config KAS_INCLUDE_KERNEL
	string
	default "kas/opt/4.4.yml"
	depends on KERNEL_4_4

config KERNEL_RT
	bool "Real-time CIP kernel"

config KAS_INCLUDE_KERNEL_RT
	string
	default "kas/opt/rt.yml"
	depends on KERNEL_RT

comment "Debian distribution options"

choice
	prompt "Debian Release"
	default DEBIAN_BUSTER

config DEBIAN_STRETCH
	bool "stretch (9)"

config DEBIAN_BUSTER
	bool "buster (10)"

config DEBIAN_BULLSEYE
	bool "bullseye (11)"

endchoice

config KAS_INCLUDE_DEBIAN
	string
	default "kas/opt/stretch.yml" if DEBIAN_STRETCH
	default "kas/opt/bullseye.yml" if DEBIAN_BULLSEYE

comment "Image features"

choice
	prompt "Image formats"
	default IMAGE_FLASH

config IMAGE_FLASH
	bool "Flashable image"

config IMAGE_ARTIFACTS
	bool "Separate artifacts for NFS boot"

endchoice

config KAS_INCLUDE_IMAGE_FORMAT
	string
	default "kas/opt/targz-img.yml" if IMAGE_ARTIFACTS && (TARGET_QEMU_AMD64 || TARGET_QEMU_ARM64 || TARGET_QEMU_ARM)
	default "kas/opt/wic-targz-img.yml" if IMAGE_ARTIFACTS && !(TARGET_QEMU_AMD64 || TARGET_QEMU_ARM64 || TARGET_QEMU_ARM)

config IMAGE_SECURITY
	bool "Security extensions"

config KAS_INCLUDE_SECURITY
	string
	default "kas/opt/security.yml" if IMAGE_SECURITY

config IMAGE_TESTING
	bool "Test extensions"

config KAS_INCLUDE_TESTING
	string
	default "kas/opt/test.yml" if IMAGE_TESTING

if IMAGE_FLASH

config IMAGE_SWUPDATE
	bool "SWUpdate support for root partition"
	depends on TARGET_QEMU_AMD64 || TARGET_SIMATIC_IPC227E

config IMAGE_SECURE_BOOT
	bool "Secure boot support"
	depends on TARGET_QEMU_AMD64
	select IMAGE_SWUPDATE

config KAS_INCLUDE_SWUPDATE_SECBOOT
	string
	default "kas/opt/ebg-swu.yml" if IMAGE_SWUPDATE && !IMAGE_SECURE_BOOT
	default "kas/opt/ebg-secure-boot-snakeoil.yml" if IMAGE_SECURE_BOOT

endif
```

## conf/distro/cip-core-bullseye.conf
```bitbake
#
# CIP Core, generic profile
#
# Copyright (c) Siemens AG, 2021-2022
#
# Authors:
#  Jan Kiszka <jan.kiszka@siemens.com>
#
# SPDX-License-Identifier: MIT
#

require conf/distro/debian-bullseye.conf
require cip-core-common.inc

PREFERRED_VERSION_linux-cip ?= "5.10.%"
PREFERRED_VERSION_linux-cip-rt ?= "5.10.%"
```

## conf/distro/cip-core-buster.conf
```bitbake
#
# CIP Core, generic profile
#
# Copyright (c) Siemens AG, 2019
#
# Authors:
#  Jan Kiszka <jan.kiszka@siemens.com>
#
# SPDX-License-Identifier: MIT
#

require conf/distro/debian-buster.conf
require cip-core-common.inc

PREFERRED_VERSION_linux-cip ?= "4.19.%"
PREFERRED_VERSION_linux-cip-rt ?= "4.19.%"
```

## conf/distro/cip-core-common.inc
```bitbake
#
# CIP Core, generic profile
#
# Copyright (c) Siemens AG, 2019
#
# Authors:
#  Jan Kiszka <jan.kiszka@siemens.com>
#
# SPDX-License-Identifier: MIT
#

KERNEL_NAME ?= "cip"

WKS_FILE ?= "${MACHINE}.wks"
```

## conf/distro/cip-core-sid-ports.conf
```bitbake
#
# CIP Core, generic profile
#
# Copyright (c) Siemens AG, 2022
#
# Authors:
#  Jan Kiszka <jan.kiszka@siemens.com>
#
# SPDX-License-Identifier: MIT
#

require conf/distro/debian-sid-ports.conf
require cip-core-common.inc

PREFERRED_VERSION_linux-cip ?= "5.10.%"
PREFERRED_VERSION_linux-cip-rt ?= "5.10.%"
```

## conf/distro/cip-core-stretch.conf
```bitbake
#
# CIP Core, generic profile
#
# Copyright (c) Siemens AG, 2019
#
# Authors:
#  Jan Kiszka <jan.kiszka@siemens.com>
#
# SPDX-License-Identifier: MIT
#

require conf/distro/debian-stretch.conf
require cip-core-common.inc

DISTRO_APT_SOURCES = "conf/distro/debian-stretch.list"

PREFERRED_VERSION_linux-cip ?= "4.19.%"
PREFERRED_VERSION_linux-cip-rt ?= "4.19.%"
```

## conf/distro/cip-core.conf
```bitbake
#
# CIP Core, generic profile
#
# Copyright (c) Siemens AG, 2019
#
# Authors:
#  Jan Kiszka <jan.kiszka@siemens.com>
#
# SPDX-License-Identifier: MIT
#

require conf/distro/debian-stretch.conf

KERNEL_NAME ?= "cip"
PREFERRED_VERSION_linux-cip ?= "4.19.%"
PREFERRED_VERSION_linux-cip-rt ?= "4.19.%"

WKS_FILE ?= "${MACHINE}.wks"
```

## conf/layer.conf
```bitbake
#
# CIP Core, generic profile
#
# Copyright (c) Siemens AG, 2019
#
# Authors:
#  Jan Kiszka <jan.kiszka@siemens.com>
#
# SPDX-License-Identifier: MIT
#

BBPATH .= ":${LAYERDIR}"

BBFILES += "${LAYERDIR}/recipes-*/*/*.bb \
        ${LAYERDIR}/recipes-*/*/*.bbappend"

BBFILE_COLLECTIONS += "cip-core"
BBFILE_PATTERN_cip-core = "^${LAYERDIR}/"
BBFILE_PRIORITY_cip-core = "6"

LAYERSERIES_COMPAT_cip-core = "next"

LAYERDIR_cip-core = "${LAYERDIR}"
LAYERDIR_cip-core[vardepvalue] = "isar-cip-core"
```

## conf/machine/bbb.conf
```bitbake
#
# CIP Core, generic profile
#
# Copyright (c) Siemens AG, 2019
#
# SPDX-License-Identifier: MIT
#

DISTRO_ARCH = "armhf"
DTB_FILES = "am335x-boneblack.dtb"

IMAGE_FSTYPES ?= "wic"
IMAGER_INSTALL += "u-boot-bbb"
IMAGER_BUILD_DEPS += "u-boot-bbb"

IMAGE_INSTALL += "u-boot-script"

USE_CIP_KERNEL_CONFIG = "1"
KERNEL_DEFCONFIG = "cip-kernel-config/${KERNEL_DEFCONFIG_VERSION}/arm/cip_bbb_defconfig"

# for SWUpdate setups: watchdog is configured in U-Boot
WDOG_TIMEOUT = "0"

PREFERRED_PROVIDER_u-boot-${MACHINE} = "u-boot-bbb"
```

## conf/machine/hihope-rzg2m.conf
```bitbake
#
# CIP Core, generic profile
#
# Copyright (c) Siemens AG, 2019
#
# Authors:
#  Quirin Gylstorff <quirin.gylstorff@siemens.com>
#
# SPDX-License-Identifier: MIT
#

DISTRO_ARCH = "arm64"

IMAGE_TYPE ?= "wic-img"

KERNEL_DEFCONFIG = "cip-kernel-config/4.19.y-cip/arm64/renesas_defconfig"
USE_CIP_KERNEL_CONFIG = "1"
DTB_FILES = "r8a774a1-hihope-rzg2m-ex.dtb"
IMAGE_BOOT_FILES = "${KERNEL_IMAGE} ${DTB_FILES}"

WIRELESS_FIRMWARE_PACKAGE = "firmware-ti-connectivity"
INSTALL_WIRELESS_TOOLS ?= "1"
```

## conf/machine/iwg20m.conf
```bitbake
#
# CIP Core, generic profile
#
# Copyright (c) Toshiba corp. 2019
#
# SPDX-License-Identifier: MIT
#
DISTRO_ARCH = "armhf"

# see wic/iwg20m.wks
IMAGE_FSTYPES ?= "wic"

# sets serial login getty
MACHINE_SERIAL = "ttySC0"
BAUDRATE_TTY = "115200"

# Setting for kernel and boot
USE_CIP_KERNEL_CONFIG = "1"
KERNEL_DEFCONFIG = "cip-kernel-config/${KERNEL_DEFCONFIG_VERSION}/arm/renesas_shmobile_defconfig"
DTB_FILES = "r8a7743-iwg20d-q7-dbcm-ca.dtb"
KERNEL_IMAGE="zImage"
IMAGE_BOOT_FILES = "${KERNEL_IMAGE} ${DTB_FILES}"
```

## conf/machine/qemu-amd64.conf
```bitbake
#
# CIP Core, generic profile
#
# Copyright (c) Siemens AG, 2019
#
# SPDX-License-Identifier: MIT
#

DISTRO_ARCH = "amd64"

IMAGE_FSTYPES ?= "ext4"
USE_CIP_KERNEL_CONFIG = "1"
KERNEL_DEFCONFIG = "cip-kernel-config/${KERNEL_DEFCONFIG_VERSION}/x86/cip_qemu_defconfig"
```

## conf/machine/qemu-arm.conf
```bitbake
#
# CIP Core, generic profile
#
# Copyright (c) Siemens AG, 2019
# Copyright (c) TOSHIBA CORPORATION, 2021
#
# SPDX-License-Identifier: MIT
#

DISTRO_ARCH = "armhf"

IMAGE_FSTYPES ?= "ext4"
USE_CIP_KERNEL_CONFIG = "1"
KERNEL_DEFCONFIG ?= "cip-kernel-config/${KERNEL_DEFCONFIG_VERSION}/arm/qemu_arm_defconfig"

# for SWUpdate setups: watchdog is configured in U-Boot
WDOG_TIMEOUT = "0"

PREFERRED_PROVIDER_u-boot-${MACHINE} = "u-boot-qemu-arm"
```

## conf/machine/qemu-arm64.conf
```bitbake
#
# CIP Core, generic profile
#
# Copyright (c) Siemens AG, 2019
#
# SPDX-License-Identifier: MIT
#

DISTRO_ARCH = "arm64"

IMAGE_FSTYPES ?= "ext4-img"
USE_CIP_KERNEL_CONFIG = "1"
KERNEL_DEFCONFIG ?= "cip-kernel-config/${KERNEL_DEFCONFIG_VERSION}/arm64/qemu_arm64_defconfig"
```

## conf/machine/qemu-riscv64.conf
```bitbake
#
# CIP Core, generic profile
#
# Copyright (c) Siemens AG, 2022
#
# Authors:
#  Jan Kiszka <jan.kiszka@siemens.com>
#
# SPDX-License-Identifier: MIT
#

DISTRO_ARCH = "riscv64"

IMAGE_FSTYPES ?= "ext4"
KERNEL_DEFCONFIG ?= "defconfig"
```

## conf/machine/simatic-ipc227e.conf
```bitbake
#
# CIP Core, generic profile
#
# Copyright (c) Siemens AG, 2019
#
# SPDX-License-Identifier: MIT
#

DISTRO_ARCH = "amd64"

IMAGE_FSTYPES ?= "wic"
IMAGER_INSTALL += "${GRUB_BOOTLOADER_INSTALL}"
USE_CIP_KERNEL_CONFIG = "1"
KERNEL_DEFCONFIG = "cip-kernel-config/${KERNEL_DEFCONFIG_VERSION}/x86/siemens_ipc227e_defconfig"
```
