## wic/simatic-ipc227e.wks
```
#
# CIP Core, generic profile
#
# Copyright (c) Siemens AG, 2019
#
# SPDX-License-Identifier: MIT
#

part /boot --source bootimg-efi-isar --sourceparams "loader=grub-efi" --label efi --part-type EF00 --align 1024

part / --source rootfs --fstype ext4 --mkfs-extraopts "-T default" --label platform --align 1024 --use-uuid

bootloader --ptable gpt --timeout 2 --append "console=ttyS0,115200"
```
